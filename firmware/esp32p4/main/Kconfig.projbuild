## firmware/esp32p4/main/Kconfig.projbuild
```kconfig
menu "Stadiacast dongle"

config DONGLE_SSID
    string "Hotspot SSID"
    default "stadiacast-dongle"
    help
        Network the Stadia controller joins. Provision the controller with this name
        (stadiacast-provision) and use the same name and password for the PC hotspot,
        so the controller works with either.

config DONGLE_PASSWORD
    string "Hotspot password (WPA2, 8 to 63 characters)"
    default "stadiacast"

config DONGLE_CHANNEL
    int "Wi-Fi channel"
    range 1 13
    default 6

config DONGLE_USB_AUDIO
    bool "USB headphones for the controller's headset jack"
    default y
    help
        Besides the gamepad, the board shows up as USB headphones (48 kHz stereo). What the
        computer plays there goes to the controller's 3.5 mm jack as Opus. Turn it off to be a
        gamepad only, as in step 3.

config DONGLE_OPUS_COMPLEXITY
    int "Opus encoder complexity"
    range 1 10
    default 8
    depends on DONGLE_USB_AUDIO
    help
        Higher is better sound for more CPU time per 20 ms frame. The serial log prints the
        encode time every 10 s while audio plays.

config DONGLE_USB_MIC
    bool "Pass the controller's microphone to the USB headset"
    default y
    depends on DONGLE_USB_AUDIO
    help
        Ask the controller for its microphone (the headset's mic) and play it as the USB
        headset's microphone (48 kHz mono). The USB microphone is there either way; without
        this it stays silent.

config DONGLE_MIC_PUSH_TO_TALK
    bool "Push to talk: the microphone only while the Assistant button is held"
    default y
    depends on DONGLE_USB_MIC
    help
        The controller is asked for its microphone when the Assistant button goes down and told
        to stop when it comes up (with 0.3 s more so the last word is kept). The USB
        microphone is silent the rest of the time. Off: the microphone is always on.

config DONGLE_PAD_MODE
    int "Gamepad mode at first power-up (0 Xbox 360, 1 DualShock 4, 2 Switch Pro, 3 HID)"
    range 0 3
    default 0
    help
        The mode the board starts in until one is picked on the controller: hold the Stadia
        button with A (Xbox 360), B (DualShock 4), X (Switch Pro) or Y (HID gamepad) for 1.5 s.
        The board remembers the last one picked.

config DONGLE_CONSOLE
    bool "USB serial console for the web console"
    default y
    select FREERTOS_USE_TRACE_FACILITY
    select FREERTOS_GENERATE_RUN_TIME_STATS
    help
        Besides the gamepad (and the headset), the board is a USB serial port that the web
        console (firmware/esp32p4/console, Chrome or Edge) reads live stats from and changes
        settings through: the mode, the headphone gain, the Opus complexity, the microphone
        and push to talk. Also FreeRTOS's run time stats, for the CPU figures.

config DONGLE_STATUS_LED_GPIO
    int "Status LED GPIO (-1 for none)"
    range -1 54
    default 3
    help
        The FireBeetle 2 ESP32-P4's own LED is on GPIO3. Fast blink: starting up. Slow blink:
        ready, wake the controller. Steady: the controller is connected.

endmenu
```
